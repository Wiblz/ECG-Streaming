## esp32/main/Kconfig.projbuild
```kconfig
menu "ECG Collector Configuration"

    config ALLOW_USB_CONFIG_PERSIST
        bool "Allow USB configuration persistence to NVS flash"
        default n
        help
            When enabled, ESP32 can persist USB configuration (target device,
            sample rates) to NVS flash when collector sends persist=true.

            When disabled (default), ESP32 ignores persist requests and never
            reads or writes config to flash. Config is always required from
            collector on every boot. This ensures collector remains source of truth.

    config LOG_STREAM_USB_CDC
        bool "Route logs over USB CDC log channel"
        default y
        help
            When enabled, ESP_LOG output is sent to the secondary USB CDC interface.
            Disable to keep logs on the default console while keeping the binary
            protobuf stream on the primary CDC interface.

    choice ECG_SAMPLE_RATE_CHOICE
        prompt "ECG Sample Rate"
        default ECG_SAMPLE_RATE_130
        help
            ECG sampling rate in Hz. Polar H10 supports 130 Hz.

        config ECG_SAMPLE_RATE_130
            bool "130 Hz"
    endchoice

    config ECG_SAMPLE_RATE
        int
        default 130 if ECG_SAMPLE_RATE_130

    choice ACC_SAMPLE_RATE_CHOICE
        prompt "Accelerometer Sample Rate"
        default ACC_SAMPLE_RATE_100
        help
            Accelerometer sampling rate in Hz. Polar H10 supports 25, 50, 100, and 200 Hz.

        config ACC_SAMPLE_RATE_25
            bool "25 Hz"

        config ACC_SAMPLE_RATE_50
            bool "50 Hz"

        config ACC_SAMPLE_RATE_100
            bool "100 Hz"

        config ACC_SAMPLE_RATE_200
            bool "200 Hz"
    endchoice

    config ACC_SAMPLE_RATE
        int
        default 25 if ACC_SAMPLE_RATE_25
        default 50 if ACC_SAMPLE_RATE_50
        default 100 if ACC_SAMPLE_RATE_100
        default 200 if ACC_SAMPLE_RATE_200

    menu "BLE PMD debug over USB"
        config DEBUG_PMD_PROTO_ENABLE
            bool "Enable PMD debug messages over USB"
            default n
            help
                Send BLE PMD notification telemetry as protobuf debug messages.

        config DEBUG_PMD_PROTO_EVERY_N
            int "PMD debug message interval (notifications)"
            default 10
            range 1 1000
            depends on DEBUG_PMD_PROTO_ENABLE
            help
                Emit one debug message every N PMD notifications.
endmenu

menu "ECG Versioning"

config ECG_APP_VERSION
    string "Firmware app version"
    default "0.1.0"
    help
        Firmware app version string reported to the collector.

config ECG_PROTOCOL_VERSION
    int "USB protocol version"
    default 1
    help
        Increment when USB protocol fields or semantics change.

endmenu

endmenu
```
